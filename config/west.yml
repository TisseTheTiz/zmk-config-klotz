## config/west.yml
```yaml
manifest:
  remotes:
    - name: zmkfirmware
      url-base: https://github.com/zmkfirmware
    - name: TisseTheTiz
      url-base: https://github.com/TisseTheTiz
  projects:
    - name: zmk
      remote: zmkfirmware
      revision: main
      import: app/west.yml
    - name: config-headers
      repo-path: zmk-config-headers
      remote: TisseTheTiz
      path: config/headers
  self:
    path: config
```
